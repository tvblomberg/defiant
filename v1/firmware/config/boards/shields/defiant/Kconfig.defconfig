## v1/firmware/config/boards/shields/defiant/Kconfig.defconfig
```kconfig
if SHIELD_DEFIANT_LEFT

config ZMK_KEYBOARD_NAME
    default "Defiant"

config ZMK_SPLIT_ROLE_CENTRAL
    default y

endif

if SHIELD_DEFIANT_RIGHT

config ZMK_KEYBOARD_NAME
    default "Defiant Right"

endif

if SHIELD_DEFIANT_LEFT || SHIELD_DEFIANT_RIGHT

config ZMK_SPLIT
    default y

config ZMK_POINTING
    default y

endif
```

## v2/firmware/config/boards/shields/defiant/Kconfig.shield
```kconfig
config SHIELD_DEFIANT_LEFT
    def_bool $(shields_list_contains,defiant_left)

config SHIELD_DEFIANT_RIGHT
    def_bool $(shields_list_contains,defiant_right)
```
